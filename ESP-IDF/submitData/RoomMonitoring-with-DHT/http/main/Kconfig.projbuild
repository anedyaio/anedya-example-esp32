## ESP-IDF/submitData/RoomMonitoring-with-DHT/http/main/Kconfig.projbuild
```kconfig
menu "Device and Anedya Configuration"
    menu "Anedya Config"
        config CONNECTION_KEY
            string "CONNECTION KEY"
            default ""
            help
                Connection key to connect to anedya.
            
        
    endmenu
    menu "Wifi Settings"
        config ESP_WIFI_SSID
            string "WiFi SSID"
            default "myssid"
            help
                SSID (network name) for the example to connect to.
                
        config ESP_WIFI_PASSWORD
            string "WiFi Password"
            default "mypassword"
            help
                WiFi password (WPA or WPA2) for the example to use.
        config WIFI_MAXIMUM_RETRY
            int "Maximum retry"
            default 5
            help
                Set the Maximum retry to avoid station reconnecting to the AP unlimited when the AP is really inexistent.

        choice ESP_WIFI_SAE_MODE
            prompt "WPA3 SAE mode selection"
            default ESP_WPA3_SAE_PWE_BOTH
            help
                Select mode for SAE as Hunt and Peck, H2E or both.
            config ESP_WPA3_SAE_PWE_HUNT_AND_PECK
                bool "HUNT AND PECK"
            config ESP_WPA3_SAE_PWE_HASH_TO_ELEMENT
                bool "H2E"
            config ESP_WPA3_SAE_PWE_BOTH
                bool "BOTH"
        endchoice

        config ESP_WIFI_PW_ID
            string "PASSWORD IDENTIFIER"
            depends on  ESP_WPA3_SAE_PWE_HASH_TO_ELEMENT|| ESP_WPA3_SAE_PWE_BOTH
            default ""
            help
                password identifier for SAE H2E

        choice ESP_WIFI_SCAN_AUTH_MODE_THRESHOLD
            prompt "WiFi Scan auth mode threshold"
            default ESP_WIFI_AUTH_WPA2_PSK
            help
                The weakest authmode to accept in the scan mode.
                This value defaults to ESP_WIFI_AUTH_WPA2_PSK incase password is present and ESP_WIFI_AUTH_OPEN is used.
                Please select ESP_WIFI_AUTH_WEP/ESP_WIFI_AUTH_WPA_PSK incase AP is operating in WEP/WPA mode.

            config ESP_WIFI_AUTH_OPEN
                bool "OPEN"
            config ESP_WIFI_AUTH_WEP
                bool "WEP"
            config ESP_WIFI_AUTH_WPA_PSK
                bool "WPA PSK"
            config ESP_WIFI_AUTH_WPA2_PSK
                bool "WPA2 PSK"
            config ESP_WIFI_AUTH_WPA_WPA2_PSK
                bool "WPA/WPA2 PSK"
            config ESP_WIFI_AUTH_WPA3_PSK
                bool "WPA3 PSK"
            config ESP_WIFI_AUTH_WPA2_WPA3_PSK
                bool "WPA2/WPA3 PSK"
            config ESP_WIFI_AUTH_WAPI_PSK
                bool "WAPI PSK"
        endchoice
    endmenu

    menu "DHT Settings"
        choice DHT_CHIP_TYPE
            prompt "Select chip type"
            default DHT_TYPE_AM2301
    
            config DHT_TYPE_DHT11
                bool "DHT11"
            config DHT_TYPE_AM2301
                bool "DHT21/DHT22/AM2301/AM2302/AM2321"
            config DHT_TYPE_SI7021
                bool "Itead Si7021"
        endchoice

        config DHT_GPIO_PIN
            int "DHT Sensor Pin"
            default 5
            help
                GPIO number connected to DATA pin

        config EXAMPLE_INTERNAL_PULLUP
            bool "Enable internal pull-up resistor"
            default 1
            help
                Check this option if you don't have external pull-up resistor on data GPIO.
                DHT sensors that come mounted on a PCB generally have pull-up resistors on the data pin.
                But for stable operation, it is recommended to provide an external pull-up resistor.
    endmenu

endmenu
```
